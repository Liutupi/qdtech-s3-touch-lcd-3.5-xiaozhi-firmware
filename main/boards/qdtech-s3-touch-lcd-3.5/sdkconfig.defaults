## main/boards/qdtech-s3-touch-lcd-3.5/sdkconfig.defaults
```kconfig
CONFIG_BOARD_TYPE_QDTECH_S3_TOUCH_LCD_3_5=y
CONFIG_PARTITION_TABLE_CUSTOM_FILENAME="partitions/v1/16m_qdtech_7m_ota.csv"
CONFIG_PARTITION_TABLE_FILENAME="partitions/v1/16m_qdtech_7m_ota.csv"
CONFIG_USE_WECHAT_MESSAGE_STYLE=y
# FC emulator needs the scarce internal SRAM on this ESP32-S3 board.
# Keep audio capture/playback, but disable local AFE wake word and noise reduction.
# CONFIG_USE_AFE_WAKE_WORD is not set
# CONFIG_USE_ESP_WAKE_WORD is not set
# CONFIG_USE_AUDIO_PROCESSOR is not set
# Phone-to-board profile/weather sync uses a small BLE GATT service.
CONFIG_BT_ENABLED=y
CONFIG_BT_BLE_ENABLED=y
CONFIG_BT_NIMBLE_ENABLED=y
# Keep BLE trimmed down: the board only needs one phone to read/write a
# small config characteristic.
CONFIG_BT_NIMBLE_MEM_ALLOC_MODE_EXTERNAL=y
# CONFIG_BT_NIMBLE_MEM_ALLOC_MODE_INTERNAL is not set
# CONFIG_BT_NIMBLE_ROLE_CENTRAL is not set
CONFIG_BT_NIMBLE_ROLE_PERIPHERAL=y
# CONFIG_BT_NIMBLE_ROLE_OBSERVER is not set
# CONFIG_BT_NIMBLE_GATT_CLIENT is not set
# CONFIG_BT_NIMBLE_SECURITY_ENABLE is not set
CONFIG_BT_NIMBLE_MAX_CONNECTIONS=1
CONFIG_BT_NIMBLE_MAX_BONDS=1
CONFIG_BT_NIMBLE_MAX_CCCDS=1
CONFIG_BT_NIMBLE_ATT_PREFERRED_MTU=128
CONFIG_BT_NIMBLE_ATT_MAX_PREP_ENTRIES=4
CONFIG_BT_NIMBLE_GATT_MAX_PROCS=1
CONFIG_BT_NIMBLE_MSYS_1_BLOCK_COUNT=8
CONFIG_BT_NIMBLE_MSYS_1_BLOCK_SIZE=128
CONFIG_BT_NIMBLE_MSYS_2_BLOCK_COUNT=8
CONFIG_BT_NIMBLE_MSYS_2_BLOCK_SIZE=128
CONFIG_BT_NIMBLE_TRANSPORT_ACL_FROM_LL_COUNT=4
CONFIG_BT_NIMBLE_TRANSPORT_ACL_SIZE=128
CONFIG_BT_NIMBLE_TRANSPORT_EVT_COUNT=8
CONFIG_BT_NIMBLE_TRANSPORT_EVT_DISCARD_COUNT=2
# CONFIG_BT_NIMBLE_50_FEATURE_SUPPORT is not set
# CONFIG_BT_NIMBLE_PROX_SERVICE is not set
# CONFIG_BT_NIMBLE_ANS_SERVICE is not set
# CONFIG_BT_NIMBLE_CTS_SERVICE is not set
# CONFIG_BT_NIMBLE_HTP_SERVICE is not set
# CONFIG_BT_NIMBLE_IPSS_SERVICE is not set
# CONFIG_BT_NIMBLE_TPS_SERVICE is not set
# CONFIG_BT_NIMBLE_IAS_SERVICE is not set
# CONFIG_BT_NIMBLE_LLS_SERVICE is not set
# CONFIG_BT_NIMBLE_SPS_SERVICE is not set
# CONFIG_BT_NIMBLE_HR_SERVICE is not set
# CONFIG_BT_NIMBLE_BAS_SERVICE is not set
# CONFIG_BT_NIMBLE_DIS_SERVICE is not set
CONFIG_BT_CTRL_BLE_MAX_ACT=2
# CONFIG_BT_CTRL_BLE_SCAN_DUPL is not set
# CONFIG_BT_CTRL_CHAN_ASS_EN is not set
# CONFIG_BT_CTRL_LE_PING_EN is not set
# CONFIG_BT_CTRL_DTM_ENABLE is not set
# CONFIG_BT_CTRL_BLE_SCAN is not set
# CONFIG_BT_CTRL_BLE_SECURITY_ENABLE is not set
CONFIG_BT_CTRL_RUN_IN_FLASH_ONLY=y
# Photo slideshow reads user files from MicroSD; long filename support avoids
# 8.3 alias/open failures with common camera or copied photo names.
# CONFIG_FATFS_LFN_NONE is not set
CONFIG_FATFS_LFN_HEAP=y
# CONFIG_FATFS_CODEPAGE_437 is not set
CONFIG_FATFS_CODEPAGE_936=y
# CONFIG_FATFS_API_ENCODING_ANSI_OEM is not set
CONFIG_FATFS_API_ENCODING_UTF_8=y
```
